## boards/shields/YG40Thumb/Kconfig
```kconfig
config BOARD_YG40THUMB
  bool "YG 40% Thumb"
  select SOC_DCDC_NRF52X
  default y
  depends on (BOARD_NICE_NANO || BOARD_NOCE_NANO_V2)
```

## boards/shields/YG40Thumb/Kconfig.board
```kconfig
# Copyright (c) 2021 Nick Winans
# SPDX-License-Identifier: MIT

config BOARD_YG40THUMB
    bool "yg40thumb"
    depends on SOC_NRF52840_QIAA
```

## boards/shields/YG40Thumb/Kconfig.defconfig
```kconfig
# Copyright (c) 2021 Nick Winans
# SPDX-License-Identifier: MIT

if BOARD_YG40THUMB

config ZMK_KEYBOARD_NAME
    default "yg40thumb"

if USB_DEVICE_STACK

config USB_NRFX
    default y

endif # USB_DEVICE_STACK

config BT_CTLR
    default BT

endif # BOARD_BOARD_YG40THUMB
```
